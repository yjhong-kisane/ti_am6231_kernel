## linux-5.10.153+gitAUTOINC+3eee621d16-g3eee621d16/drivers/char/kisan/Kconfig
```kconfig
#
# AM623x Kisan System B/D Character Device Drivers 
#

menu "Kisan AM623x B/D Character Device Drivers"

config KISAN_AM623x_CHAR
	bool "Kisan AM623x Character Device Drivers"
	default n
	help
	   Support Kisan AM623x Character Device Drivers.

config KISAN_AM623x_COMMON
    tristate "Kisan AM623x B/D Common Function"
    depends on KISAN_AM623x_CHAR
    default n
    help
       AM623x Kisan System B/D Common Function.

endmenu
```

## linux-5.10.168+gitAUTOINC+2c23e6c538-g2c23e6c538/drivers/char/kisan/Kconfig
```kconfig
#
# AM623x Kisan System B/D Character Device Drivers 
#

menu "Kisan Character Device Drivers For AM623x"

config KISAN_AM623x_CHAR
	bool "Kisan Character Device Drivers For AM623x"
	default n
	help
	   Support Kisan Character Device Drivers For AM623x.

config KISAN_AM623x_COMMON
    tristate "Kisan Common Driver For AM623x"
    depends on KISAN_AM623x_CHAR
    default n
    help
       Kisan Common Driver For AM623x.

config KISAN_AM623x_GPIO_INTR
    tristate "Kisan GPIO Interrupt Driver For AM623x"
    depends on KISAN_AM623x_CHAR
    default n
    help
       Kisan GPIO Interrupt Driver For AM623x.

config KISAN_AM623x_GPIO_HANDLER
    tristate "Kisan GPIO Handler Driver For AM623x"
    depends on KISAN_AM623x_CHAR
    default n
    help
       Kisan GPIO Handler Driver For AM623x.

config KISAN_AM623x_USB_NOTIFIER
    tristate "Kisan USB Notifier Driver For AM623x"
    depends on (USB=y || USB=USB_MUSB_HDRC) && KISAN_AM623x_CHAR
    default n
    help
       Kisan USB Notifier Driver For AM623x.

config KISAN_AM623x_BOARD_S1P
    tristate "Kisan Board S1P Driver For AM623x"
    depends on KISAN_AM623x_CHAR
    default n
    help
       Kisan Board S1P Driver For AM623x.

endmenu
```
